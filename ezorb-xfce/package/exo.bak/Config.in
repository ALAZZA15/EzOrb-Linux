## ezorb-xfce/package/exo.bak/Config.in
```kconfig
config BR2_PACKAGE_EXO
	bool "exo"
	depends on BR2_PACKAGE_LIBXFCE4UI
	help
	  Helper library for XFCE applications.
```

## ezorb-xfce/package/garcon/Config.in
```kconfig
config BR2_PACKAGE_GARCON
	bool "garcon"
	depends on BR2_PACKAGE_LIBXFCE4UI
	help
	  Menu library for XFCE.
```

## ezorb-xfce/package/libwnck3/Config.in
```kconfig
config BR2_PACKAGE_LIBWNCK3
	bool "libwnck3"
	depends on BR2_PACKAGE_LIBGTK3
	help
	  Window Navigator Construction Kit (version 3).
	  Library for writing pagers and tasklists.
```

## ezorb-xfce/package/libxfce4ui.bak/Config.in
```kconfig
config BR2_PACKAGE_LIBXFCE4UI
	bool "libxfce4ui"
	depends on BR2_PACKAGE_LIBXFCE4UTIL
	depends on BR2_PACKAGE_XFCONF
	select BR2_PACKAGE_GTK3
	help
	  Widget library for XFCE.
```

## ezorb-xfce/package/libxfce4util.bak/Config.in
```kconfig
config BR2_PACKAGE_LIBXFCE4UTIL
	bool "libxfce4util"
	help
	  Basic utility library for XFCE.
	  This is a non-validating library for
	  configuration files.
```

## ezorb-xfce/package/mousepad/Config.in
```kconfig
config BR2_PACKAGE_MOUSEPAD
	bool "mousepad"
	depends on BR2_PACKAGE_LIBXFCE4UI
	help
	  Simple text editor for XFCE.
```

## ezorb-xfce/package/thunar/Config.in
```kconfig
config BR2_PACKAGE_THUNAR
	bool "thunar"
	depends on BR2_PACKAGE_LIBXFCE4UI
	depends on BR2_PACKAGE_EXO
	help
	  File manager for XFCE.
```

## ezorb-xfce/package/xfce4-docklike-plugin/Config.in
```kconfig
config BR2_PACKAGE_XFCE4_DOCKLIKE_PLUGIN
	bool "xfce4-docklike-plugin"
	depends on BR2_PACKAGE_LIBXFCE4UI
	depends on BR2_PACKAGE_XFCE4_PANEL
	help
	  Docklike taskbar for XFCE panel.
```

## ezorb-xfce/package/xfce4-panel/Config.in
```kconfig
config BR2_PACKAGE_XFCE4_PANEL
	bool "xfce4-panel"
	depends on BR2_PACKAGE_LIBXFCE4UI
	depends on BR2_PACKAGE_XFCONF
	select BR2_PACKAGE_GARCON
	select BR2_PACKAGE_LIBWNCK3
	select BR2_PACKAGE_XLIB_LIBX11
	select BR2_PACKAGE_XLIB_LIBXEXT
	select BR2_PACKAGE_XLIB_LIBXINERAMA
	help
	  Panel for XFCE.
```

## ezorb-xfce/package/xfce4-session/Config.in
```kconfig
config BR2_PACKAGE_XFCE4_SESSION
	bool "xfce4-session"
	depends on BR2_PACKAGE_LIBXFCE4UI
	depends on BR2_PACKAGE_XFCONF
	select BR2_PACKAGE_DBUS
	select BR2_PACKAGE_DBUS_GLIB
	select BR2_PACKAGE_XLIB_LIBSM
	select BR2_PACKAGE_XLIB_LIBICE
	help
	  Session manager for XFCE.
```

## ezorb-xfce/package/xfce4-settings/Config.in
```kconfig
config BR2_PACKAGE_XFCE4_SETTINGS
	bool "xfce4-settings"
	depends on BR2_PACKAGE_LIBXFCE4UI
	depends on BR2_PACKAGE_GARCON
	depends on BR2_PACKAGE_EXO
	help
	  Settings manager for XFCE.
```

## ezorb-xfce/package/xfce4-terminal/Config.in
```kconfig
config BR2_PACKAGE_XFCE4_TERMINAL
	bool "xfce4-terminal"
	depends on BR2_PACKAGE_LIBXFCE4UI
	select BR2_PACKAGE_VTE
	help
	  Terminal emulator for XFCE.
```

## ezorb-xfce/package/xfconf/Config.in
```kconfig
config BR2_PACKAGE_XFCONF
	bool "xfconf"
	depends on BR2_PACKAGE_LIBXFCE4UTIL
	help
	  Configuration storage system for XFCE.
```

## ezorb-xfce/package/xfdesktop/Config.in
```kconfig
config BR2_PACKAGE_XFDESKTOP
	bool "xfdesktop"
	depends on BR2_PACKAGE_LIBXFCE4UI
	depends on BR2_PACKAGE_EXO
	depends on BR2_PACKAGE_LIBWNCK3
	help
	  Desktop manager for XFCE.
```

## ezorb-xfce/package/xfwm4.bak/Config.in
```kconfig
config BR2_PACKAGE_XFWM4
	bool "xfwm4"
	depends on BR2_PACKAGE_LIBXFCE4UI
	depends on BR2_PACKAGE_XFCONF
	select BR2_PACKAGE_LIBWNCK3
	select BR2_PACKAGE_XLIB_LIBXCOMPOSITE
	select BR2_PACKAGE_XLIB_LIBXDAMAGE
	help
	  Window manager for XFCE.
```
